## boards/shields/unibody/Kconfig.defconfig
```kconfig
# Copyright (c) 2021 The ZMK Contributors
# SPDX-License-Identifier: MIT

if SHIELD_UNIBODY

config ZMK_KEYBOARD_NAME
    default "Unibody"

endif

if SHIELD_UNIBODY_DONGLE
config ZMK_KEYBOARD_NAME
    default "Unibody Dongle"
config ZMK_SPLIT_ROLE_CENTRAL
    default y
config ZMK_SPLIT
    default y
config ZMK_SPLIT_BLE_CENTRAL_PERIPHERALS
    default 1
config BT_MAX_CONN
    default 6
config BT_MAX_PAIRED
    default 6
endif
```

## boards/shields/unibody/Kconfig.shield
```kconfig
# Copyright (c) 2021 The ZMK Contributors
# SPDX-License-Identifier: MIT

config SHIELD_UNIBODY
    def_bool $(shields_list_contains,unibody)

config SHIELD_UNIBODY_DONGLE
    def_bool $(shields_list_contains,unibody_dongle)
```
