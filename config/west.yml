## config/west.yml
```yaml
manifest:
  defaults:
    revision: v0.3
  remotes:
    - name: zmkfirmware
      url-base: https://github.com/zmkfirmware
    # Additional modules containing boards/shields/custom code can be listed here as well
    # See https://docs.zephyrproject.org/3.2.0/develop/west/manifest.html#projects
    - name: urob
      url-base: https://github.com/urob
    - name: zmk-leader-key
      path: modules/zmk/leader-key
      revision: 749f7faf65cc4105c82fbe64cfaa7e09a8a63605 # main (4/19/2026)
  projects:
    - name: zmk
      remote: zmkfirmware
      import: app/west.yml
    - name: zmk-unicode
      remote: urob
  self:
    path: config
```
